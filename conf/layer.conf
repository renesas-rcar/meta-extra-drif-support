## conf/layer.conf
```bitbake
# We have a conf and classes directory, add to BBPATH
BBPATH .= ":${LAYERDIR}"

# We have recipes-* directories, add to BBFILES
BBFILES += "${LAYERDIR}/recipes-*/*/*.bb \
	${LAYERDIR}/recipes-*/*/*.bbappend"

BBFILE_COLLECTIONS += "extra-drif-support"
BBFILE_PATTERN_extra-drif-support = "^${LAYERDIR}/"
BBFILE_PRIORITY_extra-drif-support = "6"
```
